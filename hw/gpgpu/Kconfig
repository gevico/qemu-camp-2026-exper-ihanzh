## hw/gpgpu/Kconfig
```kconfig
# GPGPU 设备的 Kconfig 配置
#
# 这个文件定义了 GPGPU 设备的编译选项和依赖关系
# QEMU 使用 Kconfig 系统来管理设备的条件编译

config GPGPU
    bool
    # 如果启用了 PCI_DEVICES，默认编译此设备
    default y if PCI_DEVICES
    # 依赖 PCI 总线支持和无故障的 MSI 实现
    depends on PCI && MSI_NONBROKEN
    # 默认使用 C 实现；只有显式选择 Rust 实现时才切换
    select GPGPU_C if !GPGPU_RUST
    select X_GPGPU_RUST if GPGPU_RUST
    # 可选: 如果只想在测试时编译，取消上面的注释并使用:
    # default y if TEST_DEVICES

config GPGPU_RUST
    bool
    depends on GPGPU && HAVE_RUST
    default n

config GPGPU_C
    bool
    depends on GPGPU
```

## rust/hw/Kconfig
```kconfig
# devices Kconfig
source char/Kconfig
source i2c/Kconfig
source spi/Kconfig
source timer/Kconfig
```

## rust/hw/gpgpu/Kconfig
```kconfig
# Rust 版 GPGPU 设备的 Kconfig 配置
# 这个文件只定义 Rust 实现的选择开关

config X_GPGPU_RUST
    bool
    depends on GPGPU_RUST
```
